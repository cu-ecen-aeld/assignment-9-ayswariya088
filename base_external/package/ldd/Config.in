## base_external/package/ldd/Config.in
```kconfig
config BR2_PACKAGE_LDD
	bool "ldd"
	help
	  Includes the Misc-modules and Scull components in the rootfs of the image.
	  Helps to understand buildroot external trees and package builds.
```
